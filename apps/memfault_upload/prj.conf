## CMakeLists.txt
```
cmake_minimum_required(VERSION 3.20.0)

find_package(Zephyr REQUIRED HINTS $ENV{ZEPHYR_BASE})
project(nfr_memfault_ble_mds)

target_sources(app PRIVATE src/main.c)
```

## prj.conf
```kconfig
# Application logging and shell
CONFIG_LOG=y
CONFIG_LOG_DEFAULT_LEVEL=3
CONFIG_LOG_MODE_DEFERRED=y
CONFIG_LOG_BUFFER_SIZE=2048
CONFIG_SERIAL=y
CONFIG_CONSOLE=y
CONFIG_UART_CONSOLE=y
CONFIG_SHELL=y
CONFIG_SHELL_STACK_SIZE=4096
CONFIG_SHELL_CMDS_RESIZE=n

# BLE peripheral transport for Memfault Diagnostic Service.
CONFIG_BT=y
CONFIG_BT_PERIPHERAL=y
CONFIG_BT_SMP=y
CONFIG_BT_PRIVACY=y
CONFIG_BT_SETTINGS=y
CONFIG_BT_DEVICE_NAME="NFR_Memfault"
CONFIG_BT_MDS=y
CONFIG_BT_CTLR_PHY_2M=y
CONFIG_BT_BUF_ACL_RX_SIZE=251
CONFIG_BT_L2CAP_TX_MTU=247
CONFIG_BT_BUF_ACL_TX_SIZE=251
CONFIG_BT_CTLR_DATA_LENGTH_MAX=251

# Bonding state and Memfault storage.
CONFIG_SETTINGS=y
CONFIG_NVS=y
CONFIG_FLASH_PAGE_LAYOUT=y
CONFIG_FLASH=y
CONFIG_FLASH_MAP=y
CONFIG_STREAM_FLASH=y

# Memfault
CONFIG_MEMFAULT=y
CONFIG_MEMFAULT_NCS_PROJECT_KEY="replace-with-build-env"
CONFIG_MEMFAULT_LOGGING_ENABLE=y
CONFIG_MEMFAULT_LOGGING_RAM_SIZE=1024
CONFIG_MEMFAULT_LOG_LEVEL_INF=y
CONFIG_MEMFAULT_SHELL=y
CONFIG_MEMFAULT_NCS_DEVICE_ID_STATIC=y
CONFIG_MEMFAULT_NCS_DEVICE_ID="nrf52840-memfault-ble"
CONFIG_MEMFAULT_NCS_FW_TYPE="nfr-memfault-ble"
CONFIG_MEMFAULT_NCS_BT_METRICS=y
CONFIG_MEMFAULT_NCS_INTERNAL_FLASH_BACKED_COREDUMP=y
CONFIG_PM_PARTITION_SIZE_MEMFAULT_STORAGE=0x10000

CONFIG_HEAP_MEM_POOL_SIZE=1024
CONFIG_MAIN_STACK_SIZE=2048
CONFIG_SYSTEM_WORKQUEUE_STACK_SIZE=2048
```

## src/main.c
```c
/*
 * Copyright (c) 2026
 *
 * SPDX-License-Identifier: Apache-2.0
 */

#include <errno.h>

#include <zephyr/kernel.h>
#include <zephyr/logging/log.h>
#include <zephyr/settings/settings.h>
#include <zephyr/bluetooth/bluetooth.h>
#include <zephyr/bluetooth/conn.h>
#include <zephyr/bluetooth/hci.h>

#include <bluetooth/services/mds.h>

LOG_MODULE_REGISTER(memfault_ble_mds, CONFIG_LOG_DEFAULT_LEVEL);

#define DEVICE_NAME CONFIG_BT_DEVICE_NAME
#define DEVICE_NAME_LEN (sizeof(DEVICE_NAME) - 1)

static struct bt_conn *mds_conn;

static const struct bt_data ad[] = {
	BT_DATA_BYTES(BT_DATA_FLAGS, (BT_LE_AD_GENERAL | BT_LE_AD_NO_BREDR)),
	BT_DATA_BYTES(BT_DATA_UUID128_ALL, BT_UUID_MDS_VAL),
};

static const struct bt_data sd[] = {
	BT_DATA(BT_DATA_NAME_COMPLETE, DEVICE_NAME, DEVICE_NAME_LEN),
};

static void start_advertising(void)
{
	int ret;

	ret = bt_le_adv_start(BT_LE_ADV_CONN_FAST_2, ad, ARRAY_SIZE(ad), sd, ARRAY_SIZE(sd));
	if (ret == -EALREADY) {
		return;
	}

	if (ret) {
		LOG_ERR("BLE advertising failed: %d", ret);
		return;
	}

	LOG_INF("Advertising Memfault Diagnostic Service as %s", DEVICE_NAME);
}

static bool mds_access_enable(struct bt_conn *conn)
{
	return mds_conn == conn;
}

static const struct bt_mds_cb mds_cb = {
	.access_enable = mds_access_enable,
};

static void connected(struct bt_conn *conn, uint8_t err)
{
	ARG_UNUSED(conn);

	if (err) {
		LOG_ERR("BLE connection failed: %u", err);
		return;
	}

	LOG_INF("BLE connected");
}

static void disconnected(struct bt_conn *conn, uint8_t reason)
{
	LOG_INF("BLE disconnected: 0x%02x", reason);

	if (mds_conn == conn) {
		bt_conn_unref(mds_conn);
		mds_conn = NULL;
	}

	start_advertising();
}

static void security_changed(struct bt_conn *conn, bt_security_t level, enum bt_security_err err)
{
	if (err) {
		LOG_ERR("BLE security failed: level %u err %d", level, err);
		return;
	}

	if (level < BT_SECURITY_L2) {
		return;
	}

	if (mds_conn == NULL) {
		mds_conn = bt_conn_ref(conn);
		LOG_INF("Memfault Diagnostic Service enabled for bonded peer");
	}
}

BT_CONN_CB_DEFINE(conn_callbacks) = {
	.connected = connected,
	.disconnected = disconnected,
	.security_changed = security_changed,
};

static void pairing_complete(struct bt_conn *conn, bool bonded)
{
	ARG_UNUSED(conn);
	LOG_INF("BLE pairing complete, bonded=%d", bonded);
}

static void pairing_failed(struct bt_conn *conn, enum bt_security_err reason)
{
	ARG_UNUSED(conn);
	LOG_ERR("BLE pairing failed: %d", reason);
}

static struct bt_conn_auth_cb conn_auth_callbacks;

static struct bt_conn_auth_info_cb conn_auth_info_callbacks = {
	.pairing_complete = pairing_complete,
	.pairing_failed = pairing_failed,
};

static int register_security_callbacks(void)
{
	int ret;

	ret = bt_conn_auth_cb_register(&conn_auth_callbacks);
	if (ret) {
		return ret;
	}

	return bt_conn_auth_info_cb_register(&conn_auth_info_callbacks);
}

int main(void)
{
	int ret;

	LOG_INF("Starting nRF52840 Memfault BLE MDS sample");

	ret = register_security_callbacks();
	if (ret) {
		LOG_ERR("BLE security callback registration failed: %d", ret);
		return ret;
	}

	bt_mds_cb_register(&mds_cb);

	ret = bt_enable(NULL);
	if (ret) {
		LOG_ERR("Bluetooth init failed: %d", ret);
		return ret;
	}

	if (IS_ENABLED(CONFIG_SETTINGS)) {
		settings_load();
	}

	start_advertising();

	return 0;
}
```

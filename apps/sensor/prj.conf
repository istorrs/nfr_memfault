## CMakeLists.txt
```
cmake_minimum_required(VERSION 3.20.0)

find_package(Zephyr REQUIRED HINTS $ENV{ZEPHYR_BASE})
project(nfr_memfault_sensor)

target_sources(app PRIVATE src/main.c)
```

## prj.conf
```kconfig
# Logging and shell
CONFIG_LOG=y
CONFIG_LOG_DEFAULT_LEVEL=3
CONFIG_LOG_MODE_DEFERRED=y
CONFIG_LOG_BUFFER_SIZE=2048
CONFIG_SERIAL=y
CONFIG_CONSOLE=y
CONFIG_UART_CONSOLE=y
CONFIG_SHELL=y
CONFIG_SHELL_STACK_SIZE=4096
CONFIG_SHELL_CMDS_RESIZE=n
# CONFIG_KERNEL_SHELL is default y — provides: kernel uptime, kernel version,
# kernel threads, kernel stacks, kernel reboot cold/warm

# BLE peripheral transport for Memfault Diagnostic Service
CONFIG_BT=y
CONFIG_BT_PERIPHERAL=y
CONFIG_BT_SMP=y
CONFIG_BT_PRIVACY=y
CONFIG_BT_SETTINGS=y
CONFIG_BT_DEVICE_NAME="NFR_Sensor"
CONFIG_BT_MDS=y
CONFIG_BT_MDS_PERM_RW_ENCRYPT=y
CONFIG_BT_MAX_CONN=2
CONFIG_BT_MAX_PAIRED=4
CONFIG_BT_KEYS_OVERWRITE_OLDEST=y
CONFIG_BT_CTLR_PHY_2M=y
CONFIG_BT_BUF_ACL_RX_SIZE=251
CONFIG_BT_L2CAP_TX_MTU=247
CONFIG_BT_BUF_ACL_TX_SIZE=251
CONFIG_BT_CTLR_DATA_LENGTH_MAX=251

# Bonding state and Memfault storage
CONFIG_SETTINGS=y
CONFIG_NVS=y
CONFIG_FLASH_PAGE_LAYOUT=y
CONFIG_FLASH=y
CONFIG_FLASH_MAP=y
CONFIG_STREAM_FLASH=y

# Memfault — project key injected at build time via .build-overlays/
CONFIG_MEMFAULT=y
CONFIG_MEMFAULT_NCS_PROJECT_KEY="replace-with-build-env"
CONFIG_MEMFAULT_LOGGING_ENABLE=y
CONFIG_MEMFAULT_LOGGING_RAM_SIZE=1024
CONFIG_MEMFAULT_LOG_LEVEL_INF=y
CONFIG_MEMFAULT_SHELL=y
CONFIG_MEMFAULT_NCS_DEVICE_ID_STATIC=y
CONFIG_MEMFAULT_NCS_DEVICE_ID="nrf52840-sensor"
CONFIG_MEMFAULT_NCS_FW_TYPE="nfr-sensor"
CONFIG_MEMFAULT_NCS_BT_METRICS=y
CONFIG_MEMFAULT_NCS_INTERNAL_FLASH_BACKED_COREDUMP=y
CONFIG_PM_PARTITION_SIZE_MEMFAULT_STORAGE=0x10000

# Device Information Service — required by nRF Connect Device Manager
CONFIG_BT_DIS=y
CONFIG_BT_DIS_SERIAL_NUMBER=y
CONFIG_BT_DIS_SERIAL_NUMBER_STR="nrf52840-sensor"
CONFIG_BT_DIS_HW_REV=y
CONFIG_BT_DIS_HW_REV_STR="nrf52840dk"
CONFIG_BT_DIS_SW_REV=y
CONFIG_BT_DIS_SW_REV_STR="main"
CONFIG_BT_DIS_FW_REV=y
CONFIG_BT_DIS_FW_REV_STR="0.1.0"

# Static firmware version — keep in sync with VERSION file and DIS above
CONFIG_MEMFAULT_NCS_FW_VERSION_STATIC=y
CONFIG_MEMFAULT_NCS_FW_VERSION="0.1.0"

# SMP over BLE — required for nRF Connect Device Manager to connect properly
CONFIG_ZCBOR=y
CONFIG_MCUMGR=y
CONFIG_MCUMGR_TRANSPORT_BT=y
CONFIG_MCUMGR_TRANSPORT_BT_PERM_RW_ENCRYPT=y
CONFIG_MCUMGR_GRP_OS=y
CONFIG_MCUMGR_GRP_OS_INFO=y

CONFIG_HEAP_MEM_POOL_SIZE=8192
CONFIG_MAIN_STACK_SIZE=2048
CONFIG_SYSTEM_WORKQUEUE_STACK_SIZE=4096

# Inter-component communication
CONFIG_ZBUS=y
```

## src/main.c
```c
/*
 * Copyright (c) 2026
 *
 * SPDX-License-Identifier: Apache-2.0
 */

#include <zephyr/kernel.h>
#include <zephyr/logging/log.h>
#include <zephyr/settings/settings.h>
#include <zephyr/bluetooth/bluetooth.h>
#include <zephyr/bluetooth/conn.h>
#include <zephyr/bluetooth/hci.h>

#include <bluetooth/services/mds.h>

#include <app_version.h>

LOG_MODULE_REGISTER(nfr_sensor, CONFIG_LOG_DEFAULT_LEVEL);

#define DEVICE_NAME     CONFIG_BT_DEVICE_NAME
#define DEVICE_NAME_LEN (sizeof(DEVICE_NAME) - 1)

/* Holds the connection that has been granted MDS access (requires BT_SECURITY_L2). */
static struct bt_conn *mds_conn;
static uint8_t conn_count;

static struct k_work adv_work;

static const struct bt_data ad[] = {
BT_DATA_BYTES(BT_DATA_FLAGS, (BT_LE_AD_GENERAL | BT_LE_AD_NO_BREDR)),
BT_DATA_BYTES(BT_DATA_UUID128_ALL, BT_UUID_MDS_VAL),
};

static const struct bt_data sd[] = {
BT_DATA(BT_DATA_NAME_COMPLETE, DEVICE_NAME, DEVICE_NAME_LEN),
};

static void adv_work_handler(struct k_work *work)
{
int err = bt_le_adv_start(BT_LE_ADV_CONN_FAST_2, ad, ARRAY_SIZE(ad), sd, ARRAY_SIZE(sd));

if (err && err != -EALREADY) {
LOG_ERR("BLE advertising failed: %d", err);
return;
}

LOG_INF("Advertising as %s", DEVICE_NAME);
}

static void advertising_start(void)
{
k_work_submit(&adv_work);
}

/* MDS access requires a bonded, encrypted connection (BT_SECURITY_L2). */
static bool mds_access_enable(struct bt_conn *conn)
{
return mds_conn && (conn == mds_conn);
}

static const struct bt_mds_cb mds_cb = {
.access_enable = mds_access_enable,
};

static void connected(struct bt_conn *conn, uint8_t err)
{
ARG_UNUSED(conn);

if (err) {
LOG_ERR("BLE connection failed: %u", err);
return;
}

	conn_count++;
	LOG_INF("BLE connected (active: %u)", conn_count);

	err = bt_conn_set_security(conn, BT_SECURITY_L2);
	if (err) {
		LOG_WRN("BLE security request failed: %d", err);
	}

	/* Keep advertising so a second device can connect (gateway + phone). */
	if (conn_count < CONFIG_BT_MAX_CONN) {
advertising_start();
}
}

static void disconnected(struct bt_conn *conn, uint8_t reason)
{
LOG_INF("BLE disconnected: 0x%02x", reason);

if (conn_count > 0) {
conn_count--;
}

if (mds_conn == conn) {
bt_conn_unref(mds_conn);
mds_conn = NULL;
}
/* Advertising restarts in recycled_cb once connection object is freed. */
}

/* Called when the connection object is truly freed — safe to re-advertise. */
static void recycled_cb(void)
{
advertising_start();
}

static void security_changed(struct bt_conn *conn, bt_security_t level,
     enum bt_security_err err)
{
if (err == BT_SECURITY_ERR_PIN_OR_KEY_MISSING) {
/* Bond info mismatch (device reflashed, phone has stale LTK).
 * Remove the local stale bond — the phone must also forget the
 * device in Bluetooth settings and re-pair.
 */
bt_unpair(BT_ID_DEFAULT, bt_conn_get_dst(conn));
LOG_WRN("Stale bond removed — forget device on phone and re-pair");
return;
}

if (err) {
LOG_ERR("BLE security failed: level %u err %d", level, err);
return;
}

LOG_INF("Security level %u", level);

if (level >= BT_SECURITY_L2 && !mds_conn) {
mds_conn = bt_conn_ref(conn);
LOG_INF("MDS enabled for bonded connection");
}
}

BT_CONN_CB_DEFINE(conn_callbacks) = {
.connected        = connected,
.disconnected     = disconnected,
.security_changed = security_changed,
.recycled         = recycled_cb,
};

static void auth_cancel(struct bt_conn *conn)
{
ARG_UNUSED(conn);
LOG_WRN("Pairing cancelled");
}

static struct bt_conn_auth_cb conn_auth_callbacks = {
.cancel = auth_cancel,
};

static void pairing_complete(struct bt_conn *conn, bool bonded)
{
ARG_UNUSED(conn);
LOG_INF("Pairing complete, bonded=%d", bonded);
}

static void pairing_failed(struct bt_conn *conn, enum bt_security_err reason)
{
ARG_UNUSED(conn);
LOG_ERR("Pairing failed: %d", reason);
}

static struct bt_conn_auth_info_cb conn_auth_info_callbacks = {
.pairing_complete = pairing_complete,
.pairing_failed   = pairing_failed,
};

int main(void)
{
int err;

LOG_INF("Starting NFR sensor %s", APP_VERSION_STRING);

err = bt_mds_cb_register(&mds_cb);
if (err) {
LOG_ERR("MDS callback registration failed: %d", err);
return err;
}

err = bt_enable(NULL);
if (err) {
LOG_ERR("Bluetooth init failed: %d", err);
return err;
}

err = bt_conn_auth_cb_register(&conn_auth_callbacks);
if (err) {
LOG_ERR("Auth callback registration failed: %d", err);
return err;
}

err = bt_conn_auth_info_cb_register(&conn_auth_info_callbacks);
if (err) {
LOG_ERR("Auth info callback registration failed: %d", err);
return err;
}

if (IS_ENABLED(CONFIG_SETTINGS)) {
settings_load();
}

k_work_init(&adv_work, adv_work_handler);
advertising_start();

return 0;
}
```
